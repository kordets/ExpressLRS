
/* Linker script for STM32F3xx Devices */

/* Specify the memory areas */
MEMORY
{
  RAM_CODE (rx)   : ORIGIN = 0x20000000, LENGTH = RAM_CODE_SIZE ? RAM_CODE_SIZE : 1K
  RAM_DATA (xrw)  : ORIGIN = 0x20000000 + LENGTH(RAM_CODE), LENGTH = RAM_SIZE - LENGTH(RAM_CODE)
  FLASH (rx)      : ORIGIN = 0x8000000 + FLASH_APP_OFFSET, LENGTH = FLASH_SIZE - FLASH_APP_OFFSET
}

REGION_ALIAS("DMA_DATA", RAM_DATA)

INCLUDE "variants/ldscript_gen.ld"
